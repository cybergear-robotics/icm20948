## Kconfig.projbuild
```kconfig
menu "ICM-20948 Settings"

    config ICM_20948_USE_DMP
        bool "Enable DMP support"
        default n
        help
            Enabling DMP support will include 14 KiBs of proprietary DMP firmware
 
endmenu
```

## examples/i2c_dmp_interrupt/main/Kconfig.projbuild
```kconfig
menu "ICM-20948 I2C DMP Interrupt Example"

    config ICM20948_I2C_DMP_INT_SCL_GPIO
        int "SCL GPIO number"
        default 3

    config ICM20948_I2C_DMP_INT_SDA_GPIO
        int "SDA GPIO number"
        default 9

    config ICM20948_I2C_DMP_INT_CS_GPIO
        int "CS GPIO number"
        default 18

    config ICM20948_I2C_DMP_INT_AD0_GPIO
        int "AD0 GPIO number"
        default 5

    config ICM20948_I2C_DMP_INT_GPIO
        int "INT1 GPIO number"
        default 4
        help
            GPIO connected to the ICM-20948 INT1 output.

endmenu
```

## examples/spi_dmp_interrupt/main/Kconfig.projbuild
```kconfig
menu "ICM-20948 SPI DMP Interrupt Example"

    config ICM20948_SPI_DMP_INT_MISO_GPIO
        int "MISO GPIO number"
        default 5

    config ICM20948_SPI_DMP_INT_MOSI_GPIO
        int "MOSI GPIO number"
        default 9

    config ICM20948_SPI_DMP_INT_SCK_GPIO
        int "SCK GPIO number"
        default 3

    config ICM20948_SPI_DMP_INT_CS_GPIO
        int "CS GPIO number"
        default 18

    config ICM20948_SPI_DMP_INT_GPIO
        int "INT1 GPIO number"
        default 4
        help
            GPIO connected to the ICM-20948 INT1 output.

endmenu
```

## examples/spi_interrupt/main/Kconfig.projbuild
```kconfig
menu "ICM-20948 SPI Interrupt Example"

    config ICM20948_SPI_INT_MISO_GPIO
        int "MISO GPIO number"
        default 5

    config ICM20948_SPI_INT_MOSI_GPIO
        int "MOSI GPIO number"
        default 9

    config ICM20948_SPI_INT_SCK_GPIO
        int "SCK GPIO number"
        default 3

    config ICM20948_SPI_INT_CS_GPIO
        int "CS GPIO number"
        default 18

    config ICM20948_SPI_INT_GPIO
        int "INT1 GPIO number"
        default 4
        help
            GPIO connected to the ICM-20948 INT1 output.

endmenu
```

## test/sdkconfig.defaults
```kconfig
CONFIG_IDF_TARGET="esp32s3"
CONFIG_ESP_TASK_WDT_EN=n
CONFIG_ESP_MAIN_TASK_STACK_SIZE=4096
CONFIG_ICM20948_SPI_MISO_GPIO=47
CONFIG_ICM20948_SPI_MOSI_GPIO=21
CONFIG_ICM20948_SPI_SCK_GPIO=14
CONFIG_ICM20948_SPI_CS_GPIO=13
```

## test_i2c/main/Kconfig.projbuild
```kconfig
menu "ICM-20948 I2C Test Configuration"

    config ICM20948_I2C_SCL_GPIO
        int "I2C SCL GPIO number"
        default 3
        help
            GPIO connected to the ICM-20948 I2C clock line.

    config ICM20948_I2C_SDA_GPIO
        int "I2C SDA GPIO number"
        default 9
        help
            GPIO connected to the ICM-20948 I2C data line.

    config ICM20948_I2C_CS_GPIO
        int "SPI CS GPIO number"
        default 18
        help
            ICM-20948 chip-select GPIO, driven high while testing I2C.

    config ICM20948_I2C_AD0_GPIO
        int "I2C AD0 GPIO number"
        default 5
        help
            ICM-20948 AD0/SDO GPIO, driven high to select address 0x69.

    config ICM20948_I2C_ADDRESS
        hex "I2C device address"
        default 0x69
        help
            ICM-20948 I2C address selected by the AD0 pin.

    config ICM20948_I2C_INT_GPIO
        int "INT1 GPIO number"
        default 4
        help
            GPIO connected to the ICM-20948 INT1 output.

endmenu
```

## test_i2c/sdkconfig.defaults
```kconfig
CONFIG_IDF_TARGET="esp32s3"
CONFIG_ESP_TASK_WDT_EN=n
CONFIG_ESP_MAIN_TASK_STACK_SIZE=4096
CONFIG_ICM_20948_USE_DMP=y
CONFIG_ICM20948_I2C_SCL_GPIO=3
CONFIG_ICM20948_I2C_SDA_GPIO=9
CONFIG_ICM20948_I2C_CS_GPIO=18
CONFIG_ICM20948_I2C_AD0_GPIO=5
CONFIG_ICM20948_I2C_ADDRESS=0x69
CONFIG_ICM20948_I2C_INT_GPIO=4
```

## test_spi/main/Kconfig.projbuild
```kconfig
menu "ICM-20948 SPI Test Configuration"

    config ICM20948_SPI_MISO_GPIO
        int "MISO GPIO number"
        default 5
        help
            GPIO connected to the ICM-20948 serial-data-out pin.

    config ICM20948_SPI_MOSI_GPIO
        int "MOSI GPIO number"
        default 9
        help
            GPIO connected to the ICM-20948 serial-data-in pin.

    config ICM20948_SPI_SCK_GPIO
        int "SCK GPIO number"
        default 3
        help
            GPIO connected to the ICM-20948 serial-clock pin.

    config ICM20948_SPI_CS_GPIO
        int "CS GPIO number"
        default 18
        help
            GPIO connected to the ICM-20948 chip-select pin.

    config ICM20948_SPI_INT_GPIO
        int "INT1 GPIO number"
        default 4
        help
            GPIO connected to the ICM-20948 INT1 output.

endmenu
```

## test_spi/sdkconfig.defaults
```kconfig
CONFIG_IDF_TARGET="esp32s3"
CONFIG_ESP_TASK_WDT_EN=n
CONFIG_ESP_MAIN_TASK_STACK_SIZE=4096
CONFIG_ICM_20948_USE_DMP=y
CONFIG_ICM20948_SPI_MISO_GPIO=5
CONFIG_ICM20948_SPI_MOSI_GPIO=9
CONFIG_ICM20948_SPI_SCK_GPIO=3
CONFIG_ICM20948_SPI_CS_GPIO=18
CONFIG_ICM20948_SPI_INT_GPIO=4
```
